## package/Config.in
```kconfig
menu "Packages"
source "$BR2_EXTERNAL_RK3308_PATH/package/libsox/Config.in"
source "$BR2_EXTERNAL_RK3308_PATH/package/gtkiostream/Config.in"
source "$BR2_EXTERNAL_RK3308_PATH/package/rkbin/Config.in"
source "$BR2_EXTERNAL_RK3308_PATH/package/rkbin3588/Config.in"
source "$BR2_EXTERNAL_RK3308_PATH/package/rktools/Config.in"
source "$BR2_EXTERNAL_RK3308_PATH/package/rkdevice/Config.in"
source "$BR2_EXTERNAL_RK3308_PATH/package/rtk_hciattach/Config.in"
source "$BR2_EXTERNAL_RK3308_PATH/package/example-module-overlay/Config.in"
source "$BR2_EXTERNAL_RK3308_PATH/package/rknpu2/Config.in"
source "$BR2_EXTERNAL_RK3308_PATH/package/mpp/Config.in"
source "$BR2_EXTERNAL_RK3308_PATH/package/rockchip-rga/Config.in"
source "$BR2_EXTERNAL_RK3308_PATH/package/gstreamer1-rockchip/Config.in"
source "$BR2_EXTERNAL_RK3308_PATH/package/imx586/Config.in"
source "$BR2_EXTERNAL_RK3308_PATH/package/ffrknn/Config.in"
source "$BR2_EXTERNAL_RK3308_PATH/package/sdl3/Config.in"
source "$BR2_EXTERNAL_RK3308_PATH/package/camera_engine_rkaiq/Config.in"
source "$BR2_EXTERNAL_RK3308_PATH/package/rockchip-mali-update/Config.in"
source "$BR2_EXTERNAL_RK3308_PATH/package/xdriver_xf86-video-armsoc/Config.in"
source "$BR2_EXTERNAL_RK3308_PATH/package/ffrknn-sdl2/Config.in"
source "$BR2_EXTERNAL_RK3308_PATH/package/ffrknn-sdl3/Config.in"
source "$BR2_EXTERNAL_RK3308_PATH/package/ffrknn-ocr/Config.in"
source "$BR2_EXTERNAL_RK3308_PATH/package/SDL_FontCache/Config.in"
source "$BR2_EXTERNAL_RK3308_PATH/package/box64/Config.in"
source "$BR2_EXTERNAL_RK3308_PATH/package/libnotify/Config.in"
source "$BR2_EXTERNAL_RK3308_PATH/package/gl4es/Config.in"
endmenu
```

## package/SDL_FontCache/Config.in
```kconfig
config BR2_PACKAGE_SDL_FONTCACHE
    bool "sdl_fontcache"
    help
        dependency for fonts on SDL
```

## package/ffrknn-ocr/Config.in
```kconfig
config BR2_PACKAGE_FFRKNN_OCR
    bool "ffrknn_ocr"
    select BR2_PACKAGE_SDL_FONTCACHE
    select BR2_PACKAGE_FFMPEG
    select BR2_PACKAGE_OPENCV4
    help
        ff-rknn - Real-time Object Detection with NPU (Rockchip) with LPR
```

## package/ffrknn-sdl3/Config.in
```kconfig
config BR2_PACKAGE_FFRKNN_SDL3
    bool "ffrknn_SDL3"
    select BR2_PACKAGE_SDL_FONTCACHE
    select BR2_PACKAGE_FFMPEG
    select BR2_PACKAGE_OPENCV4
    help
        ff-rknn - Real-time Object Detection with NPU (Rockchip) compiled with SDL3
```

## package/ffrknn/Config.in
```kconfig
config BR2_PACKAGE_FF-RKNN
    bool "ffrknn"
    help
        ff-rknn - Real-time Object Detection with NPU (Rockchip).

        https://github.com/avafinger/ff-rknn
```

## package/gl4es/Config.in
```kconfig
menuconfig BR2_PACKAGE_GL4ES
	bool "GL4ES"
	select BR2_PACKAGE_HAS_LIBGL
	help
	  GL4ES

config BR2_PACKAGE_PROVIDES_LIBGL
	default "gl4es"
```

## package/gstreamer1-rockchip/Config.in
```kconfig
config BR2_PACKAGE_GSTREAMER1_ROCKCHIP
	bool "Gstreamer Rockchip plugins"
	select BR2_PACKAGE_GSTREAMER1
	select BR2_PACKAGE_GST1_PLUGINS_BASE
	help
		https://github.com/MOHAMED-BEN-OTHMEN/gstreamer-rockchip-1.git
```

## package/imx586/Config.in
```kconfig
config BR2_PACKAGE_IMX586
	bool "IMX586"
	depends on BR2_LINUX_KERNEL 
help
 IMX586
```

## package/libnotify/Config.in
```kconfig
menuconfig BR2_PACKAGE_LIBNOTIFY
	bool "LIBNOTIFY"
	select BR2_PACKAGE_LIBGTK3
	select BR2_PACKAGE_GOBJECT_INTROSPECTION
	help
	  LIBNOTIFY
```

## package/rknpu2/Config.in
```kconfig
config BR2_PACKAGE_RKNPU2
	bool "rknpu2"
	help
	  "rknpu runtime lib and server"

if BR2_PACKAGE_RKNPU2

config BR2_PACKAGE_RKNPU2_EXAMPLE
	bool "rknpu2 example"
	default y

if BR2_PACKAGE_RKNPU2_EXAMPLE

config BR2_PACKAGE_RKNPU2_EXAMPLE_CM_TEST
	bool "rknpu2 commons test example"
	help
	  "rknpu2 commons test example"
	default y
config BR2_PACKAGE_RKNPU2_EXAMPLE_YOLOV5
	bool "YOLOV5 opencv4 example"
	select BR2_PACKAGE_OPENCV4
	select BR2_PACKAGE_OPENCV4_LIB_IMGPROC
	select BR2_PACKAGE_OPENCV4_LIB_IMGCODECS
	select BR2_PACKAGE_OPENCV4_LIB_VIDEO
	select BR2_PACKAGE_OPENCV4_LIB_VIDEOIO
	select BR2_PACKAGE_OPENCV4_LIB_HIGHGUI
	help
	  "rknpu2 yolov5 opencv4 demo"
	default n
endif
endif
```

## package/rockchip-mali-update/Config.in
```kconfig
config BR2_PACKAGE_MALI_UPDATE
	bool "Mali driver update"
		
	depends on BR2_PACKAGE_ROCKCHIP_MALI

	help
	  mali driver update
```

## package/sdl3/Config.in
```kconfig
config BR2_PACKAGE_SDL3
	bool "SDL3"
	select BR2_PACKAGE_ALSA_LIB
	help
	  SDL3. Unstable and not backwards compatible.

	  http://www.libsdl.org/


if BR2_PACKAGE_SDL3

config BR2_PACKAGE_SDL_FBCON
	bool "SDL framebuffer console video driver"
	default y

config BR2_PACKAGE_SDL_DIRECTFB
	bool "SDL DirectFB video driver"
	depends on BR2_PACKAGE_DIRECTFB

config BR2_PACKAGE_SDL_X11
	bool "SDL X11 video driver"
	depends on BR2_PACKAGE_XORG7
	select BR2_PACKAGE_XLIB_LIBX11
	select BR2_PACKAGE_XLIB_LIBXEXT

endif
```

## package/xdriver_xf86-video-armsoc/Config.in
```kconfig
config BR2_PACKAGE_XDRIVER_XF86_VIDEO_ARMSOC
	bool "xf86-video-armsoc"
	depends on BR2_USE_MMU # libdrm
	depends on BR2_PACKAGE_HAS_LIBGBM

	help
	  arm soc rockchip video driver
```
